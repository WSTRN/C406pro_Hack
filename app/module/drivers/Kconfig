## app/module/drivers/spl06/Kconfig
```kconfig
# SPL06 digital pressure sensor driver configuration options

config SPL06
	bool "SPL06 pressure sensor driver"
	default n
	select I2C
	select SENSOR
	help
		Enable driver for SPL06 digital pressure sensor driver.
```

## app/module/drivers/st75256/Kconfig
```kconfig
# ST75256 display driver configuration options

config ST75256
	bool "ST75256 display driver"
	default n
	select SPI
	help
		Enable driver for ST75256 display driver.

config DISPLAY_INIT_PRIORITY
	int "Display devices init priority"
	default 85
	help
	  Display devices initialization priority.

module = DISPLAY
module-str = display
source "subsys/logging/Kconfig.template.log_config"
```

## app/module/dts/bindings/goertek,spl06.yaml
```yaml
# Copyright (c) 2023 Taisheng WANG <wstrn66@gmail.com>
# SPDX-License-Identifier: Apache-2.0

description: SPL06 digital pressure sensor

compatible: "goertek,spl06"

include: [i2c-device.yaml]

properties:

  prs_cfg:
    type: uint8-array
    default: [0x00]

  tmp_cfg:
    type: uint8-array
    default: [0x00]

  cfg_reg:
    type: uint8-array
    default: [0x00]

  meas_cfg:
    type: uint8-array
    default: [0x00]





  
```

## boards/arm/C406pro/Kconfig.defconfig
```kconfig
# nRF52840 DK NRF52840 board configuration

# Copyright (c) 2016 Nordic Semiconductor ASA
# SPDX-License-Identifier: Apache-2.0

if BOARD_C406PRO

config BOARD
	default "C406pro"

config BT_CTLR
	default BT

endif # BOARD_C406PRO
```
